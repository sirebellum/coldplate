#include <avr/io.h>
#include <avr/pgmspace.h>
#include <avr/interrupt.h>
#include <util/delay.h>
#include <Wire.h>
#include <Adafruit_GFX.h>
#include <Adafruit_SSD1306.h>
#include <Adafruit_BME280.h>

#define TEMP_MIN 200         // 2.00°C -> multiply by 100 to scale
#define TEMP_MAX 700         // 7.00°C -> multiply by 100
#define TEMP_IDLE 1000       // 10.00°C
#define TEMP_THRESHOLD 1500  // 15.00°C
#define TEMP_EMERGENCY 5000  // 50.00°C
#define SEEBECK_COEFFICIENT 5000 // (Fixed-point math: 0.05 V per K * 100000)

// Cat pad temperature ranges (scaled by 100)
#define CAT_PAD_TEMP_MIN 2900  // 29.00°C
#define CAT_PAD_TEMP_MAX 3900  // 39.00°C

// PWM output pins
#define PWM_TEG_PIN PB2 // (pin 10)
#define PWM_PUMP_PIN PD5 // (pin 5)
#define PWM_FAN_PIN PD6 // (pin 6)
#define PWM_ULTRASONIC_PIN PB1 // (pin 9)

// GPIO output pins
#define TEG_AUX_PIN PB3 // (pin 11)

// Ultrasonic cleaning config
#define ULTRASONIC_FREQ 40 // Ultrasonic frequency in kHz
#define ULTRASONIC_DURATION 1000 * 60 * 5 // 5 minutes
#define ULTRASONIC_INTERVAL 1000 * 60 * 60 // 1 hour

// Adjusted Voltage Divider Constants
// Use scaled integer math for voltage calculations
#define VOLTAGE_DIVIDER_R1 15000  // Resistor R1 value in ohms
#define VOLTAGE_DIVIDER_R2 10000  // Resistor R2 value in ohms
// The above values create a voltage divider that scales 12V down to 4.8V

// OLED display config
#define SCREEN_WIDTH 128 // OLED display width, in pixels
#define SCREEN_HEIGHT 64 // OLED display height, in pixels

// Create an SSD1306 display object
Adafruit_SSD1306 display(SCREEN_WIDTH, SCREEN_HEIGHT, &Wire, -1);

// Create BME280 objects for two temperature sensors
Adafruit_BME280 bme_cold_side; // Cold side sensor (I2C)
Adafruit_BME280 bme_cat_pad;   // Cat pad temperature sensor (I2C)

// Timing variables
unsigned long last_detection_time = 0;
unsigned long last_update_time = millis();
unsigned long refresh_rate = 0;

// Ultrasonic cleaning variables
unsigned long ultrasonic_start_time = millis();
unsigned long ultrasonic_end_time = 0;
bool ultrasonic_cleaning = true;
#define SINE_TABLE_SIZE 1024
const uint16_t sine_wave[SINE_TABLE_SIZE] PROGMEM = {
    32767, 32968, 33169, 33370, 33571, 33772, 33973, 34174,
    34375, 34576, 34776, 34977, 35178, 35378, 35578, 35779,
    35979, 36179, 36379, 36578, 36778, 36978, 37177, 37376,
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    31159, 31360, 31561, 31762, 31963, 32164, 32365, 32566
};
uint8_t sine_index = 0;

// Moving Average variables
#define MOVING_AVG_WINDOW 32 // Adjust this for how many readings you want to average
int32_t cold_temp_history[MOVING_AVG_WINDOW] = {0};
int32_t fan_speed_history[MOVING_AVG_WINDOW] = {0};
int32_t pump_speed_history[MOVING_AVG_WINDOW] = {0};
int32_t teg_power_history[MOVING_AVG_WINDOW] = {0};
int32_t moving_avg_temp = 0;
int history_index = 0;
int num_readings = 0;
bool food_detected = false;

// Splash screen stuff
#define SPLASH_HEIGHT 64
#define SPLASH_WIDTH 64
const bool snowflake_splashscreen[SPLASH_HEIGHT][SPLASH_WIDTH] PROGMEM = {
    {0, 0, 0, 0, 0, 0, 0, 0, 0, 0, 0, 0, 0,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 0, 0},
    {0, 0, 0, 0, 0, 0, 0, 0, 0, 0, 0, 0, 0,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 0, 0},
    {0, 0, 0, 0, 0, 0, 0, 0, 0, 0, 0, 0, 0,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 0, 0},
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    {0, 0, 0, 0, 0, 0, 0, 0, 0, 0, 0, 0, 0,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 0, 0},
};
const bool emergency_splashscreen[SPLASH_HEIGHT][SPLASH_WIDTH] PROGMEM = {
    {0, 0, 0, 0, 0, 0, 0, 0, 0, 0, 0, 0, 0,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 0, 0},
    {0, 0, 0, 0, 0, 0, 0, 0, 0, 0, 0, 0, 0,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 0, 0},
    {0, 0, 0, 0, 0, 0, 0, 0, 0, 0, 0, 0, 0,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 0, 0},
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    {0, 1, 1, 1, 1, 1, 1, 1, 1, 1, 1, 1, 1,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 1, 0},
};

// Flags for whether I2C devices are available
bool bme_cold_side_available = false;
bool bme_cat_pad_available = false;
bool display_available = false;

// Function prototypes
void pwm_init();
void adc_init();
uint16_t adc_read(uint8_t channel);
uint8_t adjust_teg_power(int32_t current_temp, int32_t cat_pad_temp, bool food_detected);
uint8_t adjust_teg_aux_power(int32_t hot_temp);
uint8_t adjust_pump_speed(int32_t temp_diff);
uint8_t adjust_fan_speed(int32_t hot_temp);
bool check_ultrasonic_cleaning();
void set_timer2_prescaler(uint8_t prescaler);
void display_splash_screen(String message, const bool *splashscreen);
void drawBanner(String message);
void drawSplashScreen(const bool *splashscreen);
void draw_graph(int cursor_y, const int32_t* data_history, int graph_height, int graph_width, float scale_factor, int base_y);
void update_display(int32_t voltage, int32_t hot_temp, int32_t cold_temp, int32_t temp_diff, int32_t cat_pad_temp, bool food_detected);
int32_t calculate_percentile_threshold(int32_t moving_avg_temp, int32_t percentile);
bool detect_food(int32_t current_temp);

void setup() {
    // Initialize PWM
    pwm_init();

    // Initialize ADC
    adc_init();

    // Set up Timer2 for interrupt (updates the sine wave)
    TCCR2A = 0;                             // Normal mode
    TCCR2B = (1 << CS20);                   // Prescaler = None
    TIMSK2 = (1 << TOIE2);                  // Enable Timer2 overflow interrupt

    // Set Timer2 prescaler to 1 (no prescaler)
    set_timer2_prescaler(1);

    sei(); // Enable global interrupts

    // Initialize SSD1306 display
    if (display.begin(SSD1306_SWITCHCAPVCC, 0x3C)) {
        display_available = true; // Set flag if display is available
        // Display splash screen
        display_splash_screen("Cooling down...", &snowflake_splashscreen[0][0]);
    }

    // Initialize BME280 sensors
    if (bme_cold_side.begin(0x76)) {
        bme_cold_side_available = true; // Set flag if cold side sensor is available
    }

    if (bme_cat_pad.begin(0x77)) {
        bme_cat_pad_available = true; // Set flag if cat pad sensor is available
    }
    
    // Turn on TEG at full blast till cold side reaches idle temp
    // Run ultrasonic cleaning while we're at it
    OCR2B = 255; // Set TEG to full power
    OCR1B = 255 * 255; // Set pump to full power
    OCR0B = 255; // Set fan to full power
    OCR2A = 255; // Set auxillary TEG to full power
    int32_t cold_temp = bme_cold_side_available ? bme_cold_side.readTemperature() : 0.0;
    while (cold_temp > TEMP_IDLE) {
        cold_temp = bme_cold_side_available ? bme_cold_side.readTemperature() : 0.0;
        if (!ultrasonic_cleaning)
            ultrasonic_cleaning = true; // Start ultrasonic cleaning again if it was stopped
    }
}

// Timer2 overflow interrupt service routine
ISR(TIMER2_OVF_vect) {
    if (!ultrasonic_cleaning) return; // Skip if ultrasonic cleaning is not active
    uint16_t sine_value = pgm_read_word(&sine_wave[sine_index]); // Read sine value from PROGMEM
    OCR1A = sine_value; // Update PWM duty cycle
    sine_index = (sine_index + 1) % SINE_TABLE_SIZE;  // Move to the next sine value
}

void loop(void) {
    // Read ADC value from filtered voltage
    uint16_t adc_value = adc_read(0); // ADC0 connected to the RC filter output

    // Calculate the actual voltage
    int32_t measured_voltage = (adc_value * 5000) / 1023; // Voltage in millivolts (scaling by 1000)
    // Adjust for voltage divider if necessary
    int32_t voltage = measured_voltage * ((VOLTAGE_DIVIDER_R1 + VOLTAGE_DIVIDER_R2) / VOLTAGE_DIVIDER_R2);

    // Ensure voltage is within expected range
    if (voltage < 0) voltage = 0;

    // Convert voltage to temperature difference using Seebeck coefficient
    int32_t temp_diff = voltage / SEEBECK_COEFFICIENT; // Temperature difference in Kelvin

    // Read temperature from BME280 sensors
    int32_t cold_temp = bme_cold_side_available ? (int32_t)(bme_cold_side.readTemperature() * 100) : 0;
    int32_t cat_pad_temp = bme_cat_pad_available ? (int32_t)(bme_cat_pad.readTemperature() * 100) : 0;

    // Calculate hot side temperature
    int32_t hot_temp = cold_temp + temp_diff; // Calculate hot side temperature

    // Check for emergency temperature conditions
    while (cold_temp > TEMP_EMERGENCY || cat_pad_temp > TEMP_EMERGENCY) {
        // Emergency hold if temperature exceeds threshold
        OCR2B = 0; // Turn off TEG
        OCR1B = 0; // Turn off pump
        OCR0B = 0; // Turn off fan
        OCR2A = 0; // Turn off auxillary TEG
        OCR1A = 0; // Turn off ultrasonic transducer
        // Display emergency message if available
        if (display_available) {
            display_splash_screen("EMERGENCY SHUTDOWN", &emergency_splashscreen[0][0]);
        }
        // Delay for emergency shutdown
        _delay_ms(1000);
    }

    // Update the temp history array with the latest readings
    cold_temp_history[history_index] = cold_temp;

    // Detect food presence based on deviation from moving average
    food_detected = detect_food(cold_temp);

    // Adjust TEG power, pump speed, and fan speed based on temperature readings
    uint8_t teg_pwm_value = adjust_teg_power(cold_temp, cat_pad_temp, food_detected);
    uint8_t pump_pwm_value = adjust_pump_speed(temp_diff);
    uint8_t fan_pwm_value = adjust_fan_speed(cat_pad_temp);
    uint8_t teg_aux_pwm_value = adjust_teg_aux_power(hot_temp);
    bool ultrasonic_cleaning = check_ultrasonic_cleaning();

    // Update the history
    fan_speed_history[history_index] = fan_pwm_value;
    pump_speed_history[history_index] = pump_pwm_value;
    teg_power_history[history_index] = teg_pwm_value;

    // Update the history index
    history_index = (history_index + 1) % MOVING_AVG_WINDOW;

    // Update refresh rate in hz
    refresh_rate = 1000 / (millis() - last_update_time);

    // Update last update time
    last_update_time = millis();

    // Update display if available
    if (display_available) {
        update_display(voltage, hot_temp, cold_temp, cat_pad_temp, food_detected, refresh_rate);
    }
}

// Function to draw caution ribbon in the yellow section (top 16 pixels)
void drawBanner(String message) {
    display.setTextColor(SSD1306_WHITE);
    // Border
    display.drawRect(0, 0, SCREEN_WIDTH, 16, SSD1306_WHITE);

    // Draw the banner text
    display.setTextSize(1);
    display.setCursor(SCREEN_WIDTH / 2 - message.length() * 3, 2);
    display.print(message);
}

// Function to draw a detailed splash screen image in the blue section (below 16 pixels)
// Pixel values are hardcoded in splashscreen
void drawSplashScreen(const bool *splashscreen) {
    // Center the splashscreen image
    int x_offset = (SCREEN_WIDTH - SPLASH_WIDTH) / 2;
    int y_offset = (SCREEN_HEIGHT - SPLASH_HEIGHT) / 2;

    // Draw the splashscreen image
    for (int y = 0; y < SPLASH_HEIGHT; y++) {
        for (int x = 0; x < SPLASH_WIDTH; x++) {
            bool pixel = pgm_read_byte(&splashscreen[y * SPLASH_WIDTH + x]);
            display.drawPixel(x + x_offset, y + y_offset, pixel);
        }
    }
}

// Main function to draw splash screen
void display_splash_screen(String message, const bool *splashscreen) {
  display.clearDisplay();

  // Draw the banner in the top yellow section
  drawBanner(message);

  // Draw a large splash screen in the lower blue section
  drawSplashScreen(splashscreen);

  display.display(); // Push the changes to the display
}

void pwm_init() {
    // Set PWM pins as output (exclude TEG auxiliary module which is now GPIO)
    DDRB |= (1 << PWM_TEG_PIN) | (1 << PWM_PUMP_PIN); // PB1 (Ultrasonic) and PB2 (Pump)
    DDRD |= (1 << PWM_FAN_PIN) | (1 << PWM_ULTRASONIC_PIN); // PD6 (Fan), PD5 (Pump)
    
    // Set the TEG auxiliary pin as GPIO output
    DDRB |= (1 << TEG_AUX_PIN);  // Use GPIO for TEG auxiliary module

    // Set Timer0 for 8-bit Fast PWM mode: Fan (OC0A), Pump (OC0B)
    TCCR0A = (1 << WGM00) | (1 << WGM01) | (1 << COM0A1) | (1 << COM0B1); // Fast PWM, non-inverting
    TCCR0B = (1 << CS00); // No prescaler

    // Set Timer1 for 16-bit Fast PWM mode: Ultrasonic Transducer (OC1A), Pump (OC1B)
    TCCR1A = (1 << WGM11) | (1 << COM1A1) | (1 << COM1B1);  // Fast PWM, non-inverting on OC1A (Ultrasonic) and OC1B (Pump)
    TCCR1B = (1 << WGM12) | (1 << WGM13) | (1 << CS10);  // Fast PWM with ICR1 as TOP, no prescaler

    // Set ICR1 for the desired PWM frequency (e.g., 400 kHz)
    ICR1 = 39;  // This value sets the PWM frequency based on the desired sine wave resolution

    // Set initial PWM values
    OCR0A = 0; // Fan speed (OC0A, PD6)
    OCR0B = 0; // Pump speed (OC0B, PD5)
    OCR1A = 0; // Ultrasonic transducer (OC1A, PB1)
    OCR1B = 0; // Pump speed (OC1B, PB2)
    
    // Set the TEG auxiliary module GPIO to a default state (low or high)
    PORTB &= ~(1 << TEG_AUX_PIN);  // Set to low (or high if needed)
}


void adc_init() {
    // AVcc with external capacitor at AREF pin, right adjust result
    ADMUX = (1 << REFS0);
    // Enable ADC, prescaler = 128
    ADCSRA = (1 << ADEN) | (1 << ADPS2) | (1 << ADPS1) | (1 << ADPS0);
}

uint16_t adc_read(uint8_t channel) {
    // Select ADC channel
    ADMUX = (ADMUX & 0xF0) | (channel & 0x0F);
    // Start conversion
    ADCSRA |= (1 << ADSC);
    // Wait for conversion to complete
    while (ADCSRA & (1 << ADSC))
        ;
    // Return the ADC value
    return ADC;
}

void set_timer2_prescaler(uint8_t prescaler) {
    // Clear the prescaler bits (CS22, CS21, CS20)
    TCCR2B &= ~(1 << CS22) & ~(1 << CS21) & ~(1 << CS20);
    
    // Set the new prescaler value
    switch (prescaler) {
        case 1:
            TCCR2B |= (1 << CS20); // No prescaler
            break;
        case 8:
            TCCR2B |= (1 << CS21); // Prescaler = 8
            break;
        case 64:
            TCCR2B |= (1 << CS22); // Prescaler = 64
            break;
        case 256:
            TCCR2B |= (1 << CS22) | (1 << CS21); // Prescaler = 256
            break;
        case 1024:
            TCCR2B |= (1 << CS22) | (1 << CS21) | (1 << CS20); // Prescaler = 1024
            break;
        default:
            TCCR2B |= (1 << CS20); // Default to no prescaler if invalid input
            break;
    }
}

bool check_ultrasonic_cleaning() {
    // Check if ultrasonic cleaning is needed
    unsigned long current_time = millis();
    if (!ultrasonic_cleaning && (current_time - ultrasonic_end_time) >= ULTRASONIC_INTERVAL) {
        ultrasonic_cleaning = true;
        ultrasonic_start_time = current_time;
        set_timer2_prescaler(1); // Set Timer2 prescaler to 1 (no prescaler)
    } else if (ultrasonic_cleaning && (current_time - ultrasonic_start_time) >= ULTRASONIC_DURATION) {
        ultrasonic_cleaning = false;
        ultrasonic_end_time = current_time;
        set_timer2_prescaler(1024); // Set Timer2 prescaler to 1024
    }

    return ultrasonic_cleaning;
}

uint8_t adjust_teg_power(int32_t cold_temp, int32_t cat_pad_temp, bool food_detected) {
    uint8_t pwm_value = 0;

    // Adjust TEG power based on cold side temperature
    // Focus on maintaining idle temp if food is not detected
    if (!food_detected) {
        if (cold_temp < TEMP_IDLE) {
            pwm_value = 0; // If the cold side is too cold, turn off the TEG
        } else if (cold_temp > TEMP_MAX) {
            pwm_value = 255; // If the cold side is too hot, set TEG to full power
        } else {
            // Adjust TEG power based on the cold side temperature
            pwm_value = (uint8_t)((cold_temp - TEMP_IDLE) / (TEMP_MAX - TEMP_IDLE) * 255);
        }
    } else {
        if (cold_temp < TEMP_MIN) {
            pwm_value = 0; // If the cold side is too cold, turn off the TEG
        } else if (cold_temp > TEMP_MAX) {
            pwm_value = 255; // If the cold side is too hot, set TEG to full power
        } else {
            // Adjust TEG power based on the cold side temperature
            pwm_value = (uint8_t)((cold_temp - TEMP_MIN) / (TEMP_MAX - TEMP_MIN) * 255);
        }
    }

    OCR2B = pwm_value; // Set PWM value for the TEG (Pin 9)
    return pwm_value;
}

uint8_t adjust_teg_aux_power(int32_t hot_temp) {
    // Turn off the TEG auxillary gpio if the hot side temperature is too high
    if (hot_temp > TEMP_MAX) {
        PORTB &= ~(1 << TEG_AUX_PIN); // Turn off the TEG auxillary gpio
        return 0;
    } else {
        PORTB |= (1 << TEG_AUX_PIN); // Turn on the TEG auxillary gpio
        return 255;
    }
}

uint8_t adjust_pump_speed(int32_t temp_diff) {
    uint8_t pwm_value = 0;

    // Adjust pump speed based on temperature difference
    if (temp_diff < TEMP_THRESHOLD) {
        pwm_value = 0; // If the temperature difference is too low, turn off the pump
    } else {
        // Adjust pump speed based on the temperature difference
        pwm_value = (uint8_t)((temp_diff - TEMP_THRESHOLD) / (TEMP_MAX - TEMP_THRESHOLD) * 255);
    }

    OCR1B = pwm_value; // Set PWM value for the pump (Pin 10)
    return pwm_value;
}

uint8_t adjust_fan_speed(int32_t cat_pad_temp) {
    uint8_t pwm_value = 0;

    // Adjust fan speed based on cat pad temperature
    if (cat_pad_temp < CAT_PAD_TEMP_MIN) {
        pwm_value = 0; // If the cat pad is too cold, turn off the fan
    } else if (cat_pad_temp > CAT_PAD_TEMP_MAX) {
        pwm_value = 255; // If the cat pad is too hot, set fan to full power
    } else {
        // Adjust fan speed based on the cat pad temperature
        pwm_value = (uint8_t)((cat_pad_temp - CAT_PAD_TEMP_MIN) / (CAT_PAD_TEMP_MAX - CAT_PAD_TEMP_MIN) * 255);
    }

    OCR0B = pwm_value; // Set PWM value for the fan (Pin 3)
    return pwm_value;
}

void draw_graph(int cursor_y, const int32_t* data_history, int graph_height, int graph_width, float scale_factor, int base_y) {
    display.fillRect(0, cursor_y, graph_width, graph_height, SSD1306_BLACK);
    for (int i = 0; i < MOVING_AVG_WINDOW; i++) {
        int normalized_value = (int)(data_history[i] * scale_factor);
        normalized_value = constrain(normalized_value, 0, graph_height);
        display.drawPixel(i, base_y + graph_height - normalized_value, SSD1306_WHITE);
    }
}

void update_display(int32_t voltage, int32_t hot_temp, int32_t cold_temp, int32_t cat_pad_temp, bool food_detected, int32_t refresh_rate) {
    display.clearDisplay();
    display.setTextSize(1);
    display.setTextColor(SSD1306_WHITE);

    // Construct the full text string for the discrete data
    String display_buffer = "";
    String labels[6] = {"Voltage: ", "Hot Temp: ", "Cold Temp: ", "Cat Pad Temp: ", "Food Detected: ", "Refresh Rate: "};
    int32_t values[6] = {voltage/1000, hot_temp/100, cold_temp/100, cat_pad_temp/100, food_detected, refresh_rate};
    String units[6] = {"V", "°C", "°C", "°C", "", "Hz"};

    for (int i = 0; i < 6; i++) {
        display_buffer += labels[i];
        display_buffer += String(values[i]);
        display_buffer += units[i];
        if (i % 3 == 2) { // Newline after 3 items to fit into the display rows
            display_buffer += "\n";
        } else {
            display_buffer += "  "; // Space between entries in the same line
        }
    }

    // Set cursor and print the constructed string all at once
    display.setCursor(0, 0);
    display.print(display_buffer);

    // Now handle the graphs separately (graphs cannot be optimized similarly due to pixel-level drawing)
    int graph_height = 28;
    int graph_width = 128;
    String graph_labels[4] = {"Fan Speed: ", "Pump Speed: ", "TEG Power: ", "Cold Temp: "};
    int cursors_graph[4][2] = {{16, 0}, {44, 0}, {72, 0}, {100, 0}};

    // Draw fan speed graph
    display.setCursor(cursors_graph[0][0], cursors_graph[0][1]);
    display.print(graph_labels[0]);
    draw_graph(16, fan_speed_history, graph_height, graph_width, 255.0 / graph_height, 16);

    // Draw pump speed graph
    display.setCursor(cursors_graph[1][0], cursors_graph[1][1]);
    display.print(graph_labels[1]);
    draw_graph(44, pump_speed_history, graph_height, graph_width, 255.0 / graph_height, 44);

    // Draw TEG power graph
    display.setCursor(cursors_graph[2][0], cursors_graph[2][1]);
    display.print(graph_labels[2]);
    draw_graph(72, teg_power_history, graph_height, graph_width, 255.0 / graph_height, 72);

    // Draw cold side temperature graph
    display.setCursor(cursors_graph[3][0], cursors_graph[3][1]);
    display.print(graph_labels[3]);
    draw_graph(100, cold_temp_history, graph_height, graph_width, 1.0 / (TEMP_MAX - TEMP_MIN), 100);

    display.display();
}

// Function to calculate the derivative (rate of temperature change)
int32_t calculate_derivative(int32_t current_temp, int32_t previous_temp) {
    return current_temp - previous_temp;
}

// Function to calculate the dynamic threshold based on recent derivatives (rate of temperature change)
int32_t calculate_derivative_threshold(int32_t derivatives[], int num_derivatives, int32_t percentile) {
    // Sort the derivatives in ascending order
    for (int i = 0; i < num_derivatives; i++) {
        for (int j = i + 1; j < num_derivatives; j++) {
            if (derivatives[i] > derivatives[j]) {
                int32_t temp = derivatives[i];
                derivatives[i] = derivatives[j];
                derivatives[j] = temp;
            }
        }
    }

    // Calculate the index for the desired percentile
    int index = (percentile * num_derivatives) / 100;
    
    // Return the derivative at the calculated percentile
    return derivatives[index];
}

// Function to detect food based on upward temperature rate of change (derivative)
bool detect_food(int32_t current_temp) {
    if (num_readings < 2) {
        // Not enough data to calculate a derivative
        return false;
    }

    // Get the previous temperature from the history buffer
    int32_t previous_temp = cold_temp_history[(num_readings - 1) % MOVING_AVG_WINDOW];

    // Calculate the derivative (rate of temperature change)
    int32_t derivative = calculate_derivative(current_temp, previous_temp);

    // Maintain a buffer of recent derivatives to calculate a dynamic threshold
    static int32_t derivative_history[MOVING_AVG_WINDOW] = {0};
    static int num_derivatives = 0;

    derivative_history[num_derivatives % MOVING_AVG_WINDOW] = derivative;
    num_derivatives++;

    // Calculate the dynamic threshold based on the 95th percentile of recent derivatives
    int32_t threshold = calculate_derivative_threshold(derivative_history, (num_derivatives < MOVING_AVG_WINDOW ? num_derivatives : MOVING_AVG_WINDOW), 95.0);

    // Trigger only if the rate of temperature increase exceeds the threshold
    if (derivative > threshold) {
        return true; // Food detected (significant increase in heat exchange)
    }

    return false;
}
